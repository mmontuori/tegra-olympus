## arch/arm/mach-tegra/odm_kit/Kconfig
```kconfig
choice
	prompt "Select ODM kit target board"

config TEGRA_ODM_OLYMPUS
	bool "Motorola OLYMPUS brassboard/phone"
	depends on ARCH_TEGRA_2x_SOC

endchoice
```
